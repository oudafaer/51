#include "reg52.h"

typedef unsigned char u8;

u8 Tcount,kongbi,fangxiang;		//定义pwm周期，占空比，方向参数

sbit led = P2^1;

void Timer0Init();
void Timer0();
void breatheled();
/*******************************************************************************
* 函 数 名         : main
* 函数功能		   : 主函数
* 输    入         : 无
* 输    出         : 无
*******************************************************************************/
void main()
{
	Timer0Init();	//定时器初始化
	while(1)
	{
		breatheled();	//执行pwm呼吸灯
	}
}
/*******************************************************************************
* 函 数 名         : Timer0Init
* 函数功能		   : 定时器初始化
* 输    入         : 无
* 输    出         : 无
*******************************************************************************/
void Timer0Init(void)		//200微秒@11.0592MHz
{
	TMOD &= 0xF0;		//设置定时器模式
	TMOD |= 0x02;		//设置定时器模式
	TL0 = 0x48;		//设置定时初值
	TH0 = 0x48;		//设置定时重载值
	TF0 = 0;		//清除TF0标志
	ET0 = 1;		//打开定时器0中断允许
	EA  = 1;		//打开总中断
	TR0 = 1;		//定时器0开始计时
}

void Timer0() interrupt 1
{
	TL0 = 0x48;		//设置定时初值
	TH0 = 0x48;		//设置定时重载值
	
	Tcount++;
}
/*******************************************************************************
* 函 数 名         : breatheled
* 函数功能		   : pwm呼吸灯
* 输    入         : 无
* 输    出         : 无
*******************************************************************************/
void breatheled()
{
	if(Tcount>=100)		//设置pwm周期
	{
		Tcount=0;		//溢出时归零
		if(fangxiang==1)		//当方向为1，灯灭，占空比减少
		{
			kongbi--;
		}
		else if(fangxiang==0)	//当方向为0，灯亮，占空比增加
		{
			kongbi++;
		}
	}
	if(kongbi<=0)		//当占空比小于等于0，方向逆转
	{
		fangxiang=0;
	}
	else if(fangxiang>=100)		//当占空比大于等于100，方向逆转
	{
		fangxiang=1;
	}
	if(Tcount<kongbi)
	{
		led=0;
	}
	else
	{
		led=1;
	}
	
	
}